## build/conf/bblayers.conf
```bitbake
# POKY_BBLAYERS_CONF_VERSION is increased each time build/conf/bblayers.conf
# changes incompatibly
POKY_BBLAYERS_CONF_VERSION = "2"

BBPATH = "${TOPDIR}"
BBFILES ?= ""

BBLAYERS ?= " \
  /home/ubuntu/yocto-yummy/layers/poky/meta \
  /home/ubuntu/yocto-yummy/layers/poky/meta-poky \
  /home/ubuntu/yocto-yummy/layers/poky/meta-yocto-bsp \
  /home/ubuntu/yocto-yummy/layers/third-party/meta-openembedded/meta-oe \
  /home/ubuntu/yocto-yummy/layers/third-party/meta-openembedded/meta-python \
  /home/ubuntu/yocto-yummy/layers/bsp/meta-sunxi \
  /home/ubuntu/yocto-yummy/layers/third-party/meta-rauc \
  /home/ubuntu/yocto-yummy/layers/third-party/meta-rauc-community/meta-rauc-sunxi \
  /home/ubuntu/yocto-yummy/layers/meta-yummy \
  /home/ubuntu/yocto-yummy/layers/third-party/meta-mono \
  /home/ubuntu/yocto-yummy/layers/third-party/meta-openembedded/meta-networking \
  /home/ubuntu/yocto-yummy/build/workspace \
  "
```

## layers/meta-yummy/conf/layer.conf
```bitbake
# We have a conf and classes directory, add to BBPATH
BBPATH .= ":${LAYERDIR}"

# We have recipes-* directories, add to BBFILES
BBFILES += "${LAYERDIR}/recipes-*/*/*.bb \
            ${LAYERDIR}/recipes-*/*/*.bbappend"

BBFILE_COLLECTIONS += "yummy"
BBFILE_PATTERN_yummy = "^${LAYERDIR}/"
BBFILE_PRIORITY_yummy = "6"

LAYERDEPENDS_yummy = "core sunxi"
LAYERSERIES_COMPAT_yummy = "mickledore"
```

## layers/meta-yummy/conf/machine/yummy.conf
```bitbake
#@TYPE: Machine
#@NAME: yummy
#@DESCRIPTION: Machine configuration for the yummy, based on allwinner V3s CPU

require conf/machine/include/sun8i.inc


UBOOT_MACHINE = "LicheePi_Zero_defconfig"
KERNEL_DEVICETREE = "sun8i-v3s-yummy.dtb"
```
